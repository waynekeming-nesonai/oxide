## meta-oxide/conf/layer.conf
```bitbake
# We have a conf and classes directory, append to BBPATH
BBPATH .= ":${LAYERDIR}"

# We have a recipes directory, add to BBFILES
BBFILES += "${LAYERDIR}/recipes-*/*/*.bb ${LAYERDIR}/recipes-*/*/*.bbappend"

BBFILE_COLLECTIONS += "oxide"
BBFILE_PATTERN_oxide = "^${LAYERDIR}/"
BBFILE_PRIORITY_oxide = "10"

LAYERSERIES_COMPAT_oxide = "kirkstone langdale mickledore walnascar"
```
